## Kconfig
```kconfig
menu "ESP wolfSSH Client"

config SSH_CLIENT_TASK_STACK_SIZE
    int "SSH session task stack size (bytes)"
    default 16384
    help
        Stack size for the FreeRTOS task that drives the SSH session.
        wolfSSH needs roughly 8 KB minimum; 16 KB provides headroom for
        the wolfSSL crypto stack used during handshake and auth.

config SSH_CLIENT_TASK_PRIORITY
    int "SSH session task priority"
    default 5
    help
        FreeRTOS priority for the SSH session task and its writer sub-task.

config SSH_CLIENT_TX_QUEUE_DEPTH
    int "Transmit queue depth (keystrokes)"
    default 32
    help
        Number of bytes that can be queued for sending before
        ssh_client_send() starts blocking.

config SSH_CLIENT_CONNECT_TIMEOUT
    int "Connect timeout (ms)"
    default 10000
    help
        TCP connect + SSH handshake timeout in milliseconds.

config SSH_CLIENT_TERM_COLS
    int "Default terminal width (columns)"
    default 80

config SSH_CLIENT_TERM_ROWS
    int "Default terminal height (rows)"
    default 24

endmenu
```

## examples/basic_connect/main/Kconfig.projbuild
```kconfig
menu "Basic Connect Example"

config EXAMPLE_SSH_HOST
    string "SSH server hostname or IP"
    default "192.168.1.1"

config EXAMPLE_SSH_PORT
    int "SSH server port"
    default 22

config EXAMPLE_SSH_USER
    string "SSH username"
    default "user"

config EXAMPLE_SSH_PASS
    string "SSH password"
    default ""
    help
        Leave blank to disable password auth (requires key auth instead).

config EXAMPLE_WIFI_SSID
    string "WiFi SSID"
    default "myssid"

config EXAMPLE_WIFI_PASS
    string "WiFi password"
    default "mypassword"

endmenu
```

## examples/basic_connect/sdkconfig.defaults
```kconfig
# Increase main task stack — wolfSSH init can be stack-hungry
CONFIG_ESP_MAIN_TASK_STACK_SIZE=8192

# wolfSSL requires ~192 KB of heap for the ESP32 TLS stack
CONFIG_ESP_SYSTEM_EVENT_TASK_STACK_SIZE=4096

# Partition table: default single app, no OTA
CONFIG_PARTITION_TABLE_SINGLE_APP=y
```
